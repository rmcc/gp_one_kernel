## drivers/input/gsensor/Kconfig
```kconfig
#
# Input misc drivers configuration
#
menuconfig INPUT_GSENSOR
	bool "SENSOR devices"
	help
	  Say Y here, and a list of sensors input drivers will be displayed.
	  Everything that didn't fit into the other categories is here. This option
	  doesn't affect the kernel.

	  If unsure, say Y.

if INPUT_GSENSOR

#by ChihChia 2009.02.20 FIH_ZEUS
menuconfig SENSORS_BMA020
	tristate "BMA020 controller"
	depends on I2C && ARCH_MSM
	default y
	help
		Say Y here if you want to enable GSENSOR BMA020 driver.	  
endif
```

## drivers/usb/otg/Kconfig
```kconfig
menu "USB OTG drivers"
	depends on USB

config USB_MSM_OTG
	bool "OTG support for Qualcomm on-chip USB controller"
	depends on USB && USB_FUNCTION && USB_EHCI_MSM
	help
	  USB OTG driver.
	  This driver is required if you want to use USB in
	  Host mode and Device mode.

endmenu
```
